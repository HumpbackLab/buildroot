## configs/rockchip_powerfin_defconfig
```kconfig
#include "rockchip_rk3506_luckfox_defconfig"
BR2_PACKAGE_PX4_POWERFIN=y
BR2_TARGET_GENERIC_ISSUE="Welcome to PowerFin [root:powerfin]"
BR2_TARGET_GENERIC_ROOT_PASSWD="powerfin"
BR2_ROOTFS_POST_IMAGE_SCRIPT="support/scripts/genimage.sh"
BR2_ROOTFS_POST_SCRIPT_ARGS="-c board/rockchip/powerfin/genimage.cfg"
BR2_PACKAGE_HOST_DOSFSTOOLS=y
BR2_PACKAGE_HOST_GENIMAGE=y
BR2_PACKAGE_HOST_MTOOLS=y
BR2_PACKAGE_PENGUIN_FLIGHT_CONSOLE=y
```

## package/rockchip/aic8800-firmware/Config.in
```kconfig
config BR2_PACKAGE_AIC8800_FIRMWARE
	bool "AIC8800D80 USB firmware"
	help
	  Firmware files for the AIC Semiconductor AIC8800D80 USB Wi-Fi
	  device (USB ID a69c:8d80 before firmware download).
```

## package/rockchip/penguin-flight-console/Config.in
```kconfig
config BR2_PACKAGE_PENGUIN_FLIGHT_CONSOLE
	bool "Penguin Flight Console"
	select BR2_PACKAGE_WPA_SUPPLICANT
	select BR2_PACKAGE_WPA_SUPPLICANT_NL80211
	help
	  Install HumpbackLab's prebuilt USB RNDIS web manager and the
	  PowerFin board integration files.
```

## package/rockchip/px4-powerfin/Config.in
```kconfig
config BR2_PACKAGE_PX4_POWERFIN
	bool "PX4 for PowerFin"
	depends on BR2_arm
	depends on BR2_TOOLCHAIN_USES_GLIBC
	depends on BR2_INSTALL_LIBSTDCPP
	help
	  Download the latest prebuilt PX4 humpback_powerfin release and
	  install its Linux runtime under /root/px4.
```
